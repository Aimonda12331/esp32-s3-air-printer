## sdkconfig.defaults
```kconfig
CONFIG_BLINK_LED_GPIO=y
CONFIG_BLINK_GPIO=8
CONFIG_ESP_BROWNOUT_DET=n
CONFIG_ESP_PHY_MAX_WIFI_TX_POWER=15
CONFIG_ESP_PHY_MAX_TX_POWER=15
CONFIG_ESP_PHY_REDUCE_TX_POWER=y
```
